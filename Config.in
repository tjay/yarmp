## Config.in
```kconfig
menu "Python Packages"
source "$BR2_EXTERNAL_YARMP_PATH/package/python-mpd2/Config.in"
source "$BR2_EXTERNAL_YARMP_PATH/package/python-evdev/Config.in"
endmenu

menu "HTTP Frontend"
source "$BR2_EXTERNAL_YARMP_PATH/package/ympdtj/Config.in"
endmenu

menu "WLAN Configuration"

config BR2_TARGET_WLAN_SSID
        string "WLAN SSID"
        default "mywlan"
        help
         sets the wlan-ssid to connect to

config BR2_TARGET_WLAN_PSK
        string "WLAN PSK"
        default "mywlanpsk"
        help
         sets the pre shared key for the configured wlan ssid

endmenu
```

## configs/yarmp_defconfig
```kconfig
BR2_arm=y
BR2_arm1176jzf_s=y
BR2_DL_DIR="$(HOME)/.dlcache"
BR2_CCACHE=y
BR2_OPTIMIZE_3=y
BR2_PACKAGE_HOST_LINUX_HEADERS_CUSTOM_4_14=y
BR2_TOOLCHAIN_BUILDROOT_WCHAR=y
BR2_TOOLCHAIN_BUILDROOT_CXX=y
BR2_ROOTFS_MERGED_USR=y
BR2_TARGET_GENERIC_HOSTNAME="yarmp"
BR2_TARGET_GENERIC_ISSUE="Welcome to YARMP"
BR2_TARGET_GENERIC_PASSWD_SHA512=y
BR2_TARGET_GENERIC_ROOT_PASSWD="foobar"
BR2_ROOTFS_USERS_TABLES="$(BR2_EXTERNAL_YARMP_PATH)/board/yarmp/users.txt"
BR2_ROOTFS_OVERLAY="$(BR2_EXTERNAL_YARMP_PATH)/board/yarmp/overlay"
BR2_ROOTFS_POST_BUILD_SCRIPT="$(BR2_EXTERNAL_YARMP_PATH)/board/yarmp/post-build.sh"
BR2_ROOTFS_POST_IMAGE_SCRIPT="$(BR2_EXTERNAL_YARMP_PATH)/board/yarmp/post-image.sh"
BR2_LINUX_KERNEL=y
BR2_LINUX_KERNEL_CUSTOM_TARBALL=y
BR2_LINUX_KERNEL_CUSTOM_TARBALL_LOCATION="$(call github,raspberrypi,linux,6d27aa156c26977dfd079a7107e31670127d17d3)/linux-6d27aa156c26977dfd079a7107e31670127d17d3.tar.gz"
BR2_LINUX_KERNEL_USE_CUSTOM_CONFIG=y
BR2_LINUX_KERNEL_CUSTOM_CONFIG_FILE="$(BR2_EXTERNAL_YARMP_PATH)/board/yarmp/linux.config"
BR2_LINUX_KERNEL_DTS_SUPPORT=y
BR2_LINUX_KERNEL_INTREE_DTS_NAME="bcm2708-rpi-0-w"
BR2_PACKAGE_BUSYBOX_SHOW_OTHERS=y
BR2_PACKAGE_ALSA_UTILS=y
BR2_PACKAGE_ALSA_UTILS_ALSACONF=y
BR2_PACKAGE_ALSA_UTILS_ALSALOOP=y
BR2_PACKAGE_ALSA_UTILS_AMIXER=y
BR2_PACKAGE_ALSA_UTILS_APLAY=y
BR2_PACKAGE_ALSA_UTILS_SPEAKER_TEST=y
BR2_PACKAGE_MPD=y
BR2_PACKAGE_MPD_MPG123=y
BR2_PACKAGE_MPD_CURL=y
BR2_PACKAGE_MPD_LIBMPDCLIENT=y
BR2_PACKAGE_MPD_MPC=y
BR2_PACKAGE_RPI_FIRMWARE=y
BR2_PACKAGE_RPI_WIFI_FIRMWARE=y
BR2_PACKAGE_MINICOM=y
BR2_PACKAGE_PPS_TOOLS=y
BR2_PACKAGE_PYTHON=y
BR2_PACKAGE_PYTHON_BZIP2=y
BR2_PACKAGE_PYTHON_BSDDB=y
BR2_PACKAGE_PYTHON_CURSES=y
BR2_PACKAGE_PYTHON_OSSAUDIODEV=y
BR2_PACKAGE_PYTHON_READLINE=y
BR2_PACKAGE_PYTHON_SSL=y
BR2_PACKAGE_PYTHON_SQLITE=y
BR2_PACKAGE_PYTHON_HASHLIB=y
BR2_PACKAGE_PYTHON_ALSAAUDIO=y
BR2_PACKAGE_PYTHON_CERTIFI=y
BR2_PACKAGE_PYTHON_CHARDET=y
BR2_PACKAGE_PYTHON_IDNA=y
BR2_PACKAGE_PYTHON_PYYAML=y
BR2_PACKAGE_PYTHON_SCANDIR=y
BR2_PACKAGE_PYTHON_SERIAL=y
BR2_PACKAGE_PYTHON_SH=y
# BR2_PACKAGE_LIBMAD_ASO is not set
BR2_PACKAGE_CA_CERTIFICATES=y
BR2_PACKAGE_LIBRESSL=y
BR2_PACKAGE_LIBRESSL_BIN=y
BR2_PACKAGE_SQLITE_STAT3=y
BR2_PACKAGE_CURL=y
BR2_PACKAGE_LIBCURL_VERBOSE=y
BR2_PACKAGE_PCRE=y
BR2_PACKAGE_PCRE_UCP=y
BR2_PACKAGE_DROPBEAR=y
BR2_PACKAGE_DROPBEAR_DISABLE_REVERSEDNS=y
BR2_PACKAGE_NTP=y
# BR2_PACKAGE_NTP_NTPD is not set
BR2_PACKAGE_NTP_NTPDATE=y
BR2_PACKAGE_RSYNC=y
BR2_PACKAGE_WPA_SUPPLICANT=y
BR2_PACKAGE_WPA_SUPPLICANT_AUTOSCAN=y
BR2_PACKAGE_WPA_SUPPLICANT_CLI=y
BR2_PACKAGE_WPA_SUPPLICANT_WPA_CLIENT_SO=y
BR2_PACKAGE_WPA_SUPPLICANT_PASSPHRASE=y
BR2_PACKAGE_SUDO=y
BR2_PACKAGE_KMOD=y
BR2_PACKAGE_UTIL_LINUX=y
BR2_PACKAGE_UTIL_LINUX_LIBBLKID=y
BR2_TARGET_ROOTFS_EXT2=y
BR2_TARGET_ROOTFS_EXT2_4=y
BR2_TARGET_ROOTFS_EXT2_SIZE="180M"
BR2_TARGET_ROOTFS_EXT2_MKFS_OPTIONS="-O 64bit"
# BR2_TARGET_ROOTFS_TAR is not set
BR2_PACKAGE_HOST_DOSFSTOOLS=y
BR2_PACKAGE_HOST_GENEXT2FS=y
BR2_PACKAGE_HOST_GENIMAGE=y
BR2_PACKAGE_HOST_MTOOLS=y
BR2_PACKAGE_PYTHON_MPD2=y
BR2_PACKAGE_PYTHON_EVDEV=y
BR2_TARGET_WLAN_SSID=""
BR2_TARGET_WLAN_PSK=""
```

## package/python-evdev/Config.in
```kconfig
config BR2_PACKAGE_PYTHON_EVDEV
	bool "python-evdev"
	depends on BR2_PACKAGE_PYTHON
	help
		This package provides bindings to the generic input event interface in Linux.
		The evdev interface serves the purpose of passing events generated in the kernel directly to userspace through character devices that are typically located in /dev/input/.	  
```

## package/python-mpd2/Config.in
```kconfig
config BR2_PACKAGE_PYTHON_MPD2
	bool "python-mpd2"
	depends on BR2_PACKAGE_PYTHON
	help
	  python-mpd2 is a Python library which provides a client interface for the Music Player Daemon.
	  

	  https://github.com/Mic92/python-mpd2
```

## package/python-rpio/Config.in
```kconfig
config BR2_PACKAGE_PYTHON_RPIO
	bool "python-rpio"
	depends on BR2_PACKAGE_PYTHON
	help
	  RPIO is an advanced GPIO module for the Raspberry Pi.
	  

	  https://github.com/metachris/RPIO
```
